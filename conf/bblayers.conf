## conf/bblayers.conf
```bitbake
# POKY_BBLAYERS_CONF_VERSION is increased each time build/conf/bblayers.conf
# changes incompatibly
POKY_BBLAYERS_CONF_VERSION = "2"

BBPATH = "${TOPDIR}"
BBFILES ?= ""

BBLAYERS ?= " \
  ${TOPDIR}/../poky/meta \
  ${TOPDIR}/../poky/meta-poky \
  ${TOPDIR}/../poky/meta-yocto-bsp \
  ${TOPDIR}/../yocto-ai-drone_meta_conf/meta-lm \
  \
  ${TOPDIR}/../meta-rockchip \
  ${TOPDIR}/../meta-arm/meta-arm \
  ${TOPDIR}/../meta-arm/meta-arm-toolchain \
  ${TOPDIR}/../meta-linux-mainline \
"
```

## meta-lm/conf/layer.conf
```bitbake
# We include machine definitions for LM boards
BBPATH .= ":${LAYERDIR}"

BBFILES += "${LAYERDIR}/recipes-*/*/*.bb \
            ${LAYERDIR}/recipes-*/*/*.bbappend"

BBFILE_COLLECTIONS += "lm"
BBFILE_PATTERN_lm = "^${LAYERDIR}/"
BBFILE_PRIORITY_lm = "9"

LAYERSERIES_COMPAT_lm = "wrynose whinlatter"
LAYERDEPENDS_lm = "core rockchip"
```
